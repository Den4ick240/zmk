## config/boards/shields/kaboba/Kconfig.defconfig
```kconfig
if SHIELD_KABOBA_DONGLE

config ZMK_KEYBOARD_NAME
  default "Kaboba"

config ZMK_SPLIT_ROLE_CENTRAL
  default y

endif

if SHIELD_KABOBA_LEFT || SHIELD_KABOBA_RIGHT || SHIELD_KABOBA_DONGLE

config ZMK_SPLIT
  default y

endif
```

## config/boards/shields/kaboba/Kconfig.shield
```kconfig
config SHIELD_KABOBA_LEFT
  def_bool $(shields_list_contains, kaboba_left)

config SHIELD_KABOBA_RIGHT
  def_bool $(shields_list_contains, kaboba_right)

config SHIELD_KABOBA_DONGLE
  def_bool $(shields_list_contains, kaboba_dongle)
```
